/*
*********************************************************************************************************
*                                        BOARD SUPPORT PACKAGE
*
*                                        Bootloader (bare-metal)
*
* Filename      : bsp.c
*********************************************************************************************************
*/

#include "bsp.h"


/*
*********************************************************************************************************
*                                               BSP_Init()
*********************************************************************************************************
*/

void  BSP_Init (void)
{
    BSP_LED_Init();
}


/*
*********************************************************************************************************
*                                            BSP_LED_Init()
*********************************************************************************************************
*/

void  BSP_LED_Init (void)
{
    GPIO_InitTypeDef  GPIO_InitStructure;

    RCC_APB2PeriphClockCmd(LED_RCC, ENABLE);

    GPIO_InitStructure.GPIO_Pin   = LED_PIN;
    GPIO_InitStructure.GPIO_Mode  = GPIO_Mode_Out_PP;
    GPIO_InitStructure.GPIO_Speed = GPIO_Speed_50MHz;
    GPIO_Init(LED_PORT, &GPIO_InitStructure);

    LED_OFF();                         /* 初始灭灯 */
}


/*
*********************************************************************************************************
*                                            JumpToApp()
*
* Description : 跳转到 App 固件（0x0800C000）。
*               1. 关闭全局中断
*               2. 设置 MSP = App 栈顶（App 固件首字）
*               3. 跳转到 App 复位向量（App 固件第二字）
*********************************************************************************************************
*/

void  JumpToApp (void)
{
    uint32_t  app_stack;
    uint32_t  app_entry;

    __disable_irq();

    /* 检查 App 固件头是否有效（首字应为合理的栈地址，在 RAM 范围内） */
    app_stack = *(volatile uint32_t *)APP_ADDRESS;
    if ((app_stack & 0x2FFE0000) != 0x20000000) {
        /* App 无效，不复位，死循环等看门狗/调试 */
        while (1);
    }

    app_entry = *(volatile uint32_t *)(APP_ADDRESS + 4);
    if (app_entry < 0x08000000 || app_entry > 0x08080000) {
        while (1);                     /* 入口地址非法 */
    }

    /* 复位所有外设到默认状态（可选，简化版跳过） */
    __set_MSP(app_stack);              /* 设置 App 的主栈指针 */
    ((void (*)(void))app_entry)();     /* 跳转到 App 复位向量 */
}


/*
*********************************************************************************************************
*                                            SoftReset()
*********************************************************************************************************
*/

void  SoftReset (void)
{
    __disable_irq();
    NVIC_SystemReset();
}
