/*
*********************************************************************************************************
*                                        BOOTLOADER
*
*                                       STM32F103VE (bare-metal)
*
* Filename      : main.c
* Description   : PE0 闪灯诊断 → boot_main() 状态机（验签/备份/解密/升级/跳转App）
*                 不跑操作系统。位于 0x08000000，限制 48KB。
*********************************************************************************************************
*/

#include "stm32f10x.h"
#include "bsp.h"
#include "boot_main.h"


/*
*********************************************************************************************************
*                                            LOCAL DEFINES
*********************************************************************************************************
*/

#define  BLINK_COUNT     5u
#define  BLINK_DLY_MS    500u


/*
*********************************************************************************************************
*                                          SIMPLE DELAY
*********************************************************************************************************
*/

static void  DelayMs (volatile uint32_t ms)
{
    volatile uint32_t  i;
    while (ms--) {
        for (i = 0; i < 7200; i++) {
            __NOP();
        }
    }
}


/*
*********************************************************************************************************
*                                                main()
*********************************************************************************************************
*/

int  main (void)
{
    uint32_t  i;

    BSP_Init();
    flash_ext_init();                              /* 初始化片外 SPI flash（W25Q64）            */

    /* ---- PE0 闪灯诊断（5 次 1Hz）---- */
    for (i = 0; i < BLINK_COUNT; i++) {
        LED_ON();
        DelayMs(BLINK_DLY_MS);
        LED_OFF();
        DelayMs(BLINK_DLY_MS);
    }

    /* ---- Bootloader 状态机（验签/备份/解密/跳转）---- */
    boot_main();                                   /* 不返回                                    */

    while (1);
}
